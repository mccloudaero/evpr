## electronics/firmware_evpr_master/main/Kconfig.projbuild
```kconfig
menu "EVPR Master Node Configuration"

config WIFI_SSID
    string "WiFi SSID"
    default "evpr_master"
    help
	SSID (network name) for the master node.

config WIFI_PASSWORD
    string "WiFi Password"
    default "1234567890"
    help
	WiFi password (WPA or WPA2) for the master node.

config BLINK_GPIO 
    int "Status GPIO Pin"
    default 13 
    help
	GPIO pin to use for status light.

endmenu
```

## electronics/firmware_evpr_slave/main/Kconfig.projbuild
```kconfig
menu "EVPR Slave Node Configuration"

config ROTOR_NUM 
    int "Rotor Number"
    default 1 
    range 1 4 
    help
	Device Number (1-4).

config ROTOR_MODE 
    int "Rotor Mode"
    default 2 
    range 0 2 
    help
	Device Mode (0-2) 0-Self Test, 1-Position Hold, 2-Nominal.

config BLINK_GPIO 
    int "Status GPIO Pin"
    default 13 
    help
	GPIO pin to use for status light.

config ESPNOW_PMK
    string "ESPNOW primary master key"
    default "pmk1234567890123"
    help
        ESPNOW primary master for the example to use. The length of ESPNOW primary master must be 16 bytes.

config ESPNOW_LMK
    string "ESPNOW local master key"
    default "lmk1234567890123"
    help
        ESPNOW local master for the example to use. The length of ESPNOW local master must be 16 bytes.

config ESPNOW_CHANNEL
    int "Channel"
    default 1
    range 1 13
    help
        The channel on which sending and receiving ESPNOW data.

config ESPNOW_SEND_COUNT
    int "Send count"
    default 100
    range 1 65535
    help
        Total count of unicast ESPNOW data to be sent.

config ESPNOW_SEND_DELAY
    int "Send delay"
    default 1000
    range 0 65535
    help
        Delay between sending two ESPNOW data, unit: ms.

config ESPNOW_SEND_LEN
    int "Send len"
    range 10 250
    default 200
    help
        Length of ESPNOW data to be sent, unit: byte.

endmenu
```

## firmware/EVPRNode/main/Kconfig.projbuild
```kconfig
menu "EVPR Node Configuration"

config EVPR_NODETYPE
    int "EVPR Node Type. 0:Head, 1:Rotor, 2:Listener"
    default 0
    range 0 2
    help
        0 -> Head, 1 -> Rotor, 2 -> Listener

config EVPR_NODEID
    int "EVPR Node ID. The node ID 0 is reserved for head. This setting is ignored if in head mode."
    default 1
    range 1 12

config ESPNOW_PMK
    string "ESPNOW primary master key (NOT IMPLEMENTED)"
    default "pmk1234567890123"
    help
        ESPNOW primary master for the example to use. The length of ESPNOW primary master must be 16 bytes.

config ESPNOW_LMK
    string "ESPNOW local master key (NOT IMPLEMENTED)"
    default "lmk1234567890123"
    help
        ESPNOW local master for the example to use. The length of ESPNOW local master must be 16 bytes.

config ESPNOW_CHANNEL
    int "Channel (NOT IMPLEMENTED)"
    default 1
    range 1 13
    help
        The channel on which sending and receiving ESPNOW data.

endmenu
```

## firmware/PX4 UART Driver/Kconfig
```kconfig
 menuconfig DRIVERS_UART_OUT
	bool "uart_out"
	default n
	---help---
		Enable UART actuator output (support for uart_out)
```

## firmware/rotor/main/Kconfig.projbuild
```kconfig
menu "EVPR Rotor Configuration"

config ROTOR_NUM 
    int "Rotor Number"
    default 1 
    range 1 4 
    help
	Device Number (1-4).

config ROTOR_MODE 
    int "Rotor Mode"
    default 2 
    range 0 2 
    help
	Device Mode (0-2) 0-Self Test, 1-Position Hold, 2-Nominal.

config PWMA_PIN 
    int "PWMA Pin"
    default 23 
    help
	Pin to use for PWM A.

config PWMB_PIN 
    int "PWMB Pin"
    default 25 
    help
	Pin to use for PWM A.

config DSTAR_SDA_PIN 
    int "SDA Pin"
    default 27 
    help
	Pin to use for Dotstar SDA.

config DSTAR_CLK_PIN 
    int "CLK Pin"
    default 13 
    help
	Pin to use for Dotstar CLK.

config BLINK_GPIO 
    int "Status GPIO Pin"
    default 13 
    help
	GPIO pin to use for status light.

config USING_BAT_GPIO 
    int "Using BAT GPIO Pin"
    default 4 
    help
	GPIO pin to check if on battery power.

config USING_ENG_GPIO 
    int "Using ENG GPIO Pin"
    default 17 
    help
	GPIO pin to check if on engine power.

config BAT_EN_GPIO 
    int "Battery Power Enable GPIO Pin"
    default 21 
    help
	GPIO pin to enable battery power sensing.

config TACH_GPIO 
    int "Tachometer GPIO Pin"
    default 16 
    help
	GPIO pin to monitor rotor speed.

config ENG_EN_GPIO 
    int "ENG Power Enable GPIO Pin"
    default 26 
    help
	GPIO pin to check if on engine power.

config ESPNOW_PMK
    string "ESPNOW primary master key"
    default "pmk1234567890123"
    help
        ESPNOW primary master for the example to use. The length of ESPNOW primary master must be 16 bytes.

config ESPNOW_LMK
    string "ESPNOW local master key"
    default "lmk1234567890123"
    help
        ESPNOW local master for the example to use. The length of ESPNOW local master must be 16 bytes.

config ESPNOW_CHANNEL
    int "Channel"
    default 1
    range 1 13
    help
        The channel on which sending and receiving ESPNOW data.

config ESPNOW_SEND_COUNT
    int "Send count"
    default 100
    range 1 65535
    help
        Total count of unicast ESPNOW data to be sent.

config ESPNOW_SEND_DELAY
    int "Send delay"
    default 1000
    range 0 65535
    help
        Delay between sending two ESPNOW data, unit: ms.

config ESPNOW_SEND_LEN
    int "Send len"
    range 10 250
    default 200
    help
        Length of ESPNOW data to be sent, unit: byte.

endmenu
```
